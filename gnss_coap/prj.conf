## Kconfig
```
#
# Copyright (c) 2020 Nordic Semiconductor ASA
#
# SPDX-License-Identifier: LicenseRef-Nordic-5-Clause
#

menu "GNSS UDP Setttings"

config GNSS_SIMULATE_FIX
	bool "Simulated GPS Fix"
	default n

config UDP_DATA_UPLOAD_SIZE_BYTES
	int "Number of bytes transmitted to the server"
	default 10

config UDP_DATA_UPLOAD_FREQUENCY_SECONDS
	int "How often data is transmitted to the server"
	default 900

config UDP_SERVER_ADDRESS_STATIC
	string "UDP server IP address"
	default "8.8.8.8"

config UDP_SERVER_PORT
	int "UDP server port number"
	default "2469"

config UDP_PSM_ENABLE
	bool "Enable LTE Power Saving Mode"
	default y

config UDP_EDRX_ENABLE
	bool "Enable LTE enhanced Discontinuous Reception"

config UDP_RAI_ENABLE
	bool "Enable LTE Release Assistance Indication"

config GNSS_PERIODIC_INTERVAL
	int "Fix interval for periodic GPS fixes"
	range 10 65535
	default 120
	help
	  Fix interval (in seconds) for periodic fixes.

config GNSS_PERIODIC_TIMEOUT
	int "Fix timeout for periodic GPS fixes"
	range 0 65535
	default 480
	help
	  Fix timeout (in seconds) for periodic fixes.
	  If set to zero, GNSS is allowed to run indefinitely until a valid PVT estimate is produced.

endmenu

module = UDP
module-str = UDP sample
source "${ZEPHYR_BASE}/subsys/logging/Kconfig.template.log_config"

menu "Zephyr Kernel"
source "Kconfig.zephyr"
endmenu
```

## prj.conf
```kconfig
#
# Copyright (c) 2020 Nordic Semiconductor ASA
#
# SPDX-License-Identifier: LicenseRef-Nordic-5-Clause
#

CONFIG_GNSS_SIMULATE_FIX=y

# General config
CONFIG_PM=y
CONFIG_PM_DEVICE=y
CONFIG_FPU=y
CONFIG_NEWLIB_LIBC=y
CONFIG_NEWLIB_LIBC_FLOAT_PRINTF=y
CONFIG_THREAD_NAME=y
CONFIG_DATE_TIME=y
CONFIG_DATE_TIME_AUTO_UPDATE=y
CONFIG_DATE_TIME_MODEM=y
CONFIG_DATE_TIME_NTP=y
CONFIG_DATE_TIME_LOG_LEVEL_DBG=y

#Debugs - Turn off to low Power
CONFIG_SERIAL=y
CONFIG_LOG=y
CONFIG_NRF_MODEM_LIB_TRACE=n

# Network
CONFIG_NETWORKING=y
CONFIG_NET_NATIVE=n
CONFIG_NET_SOCKETS=y
CONFIG_NET_SOCKETS_OFFLOAD=y

# LTE link control
CONFIG_LTE_LINK_CONTROL=y
CONFIG_LTE_AUTO_INIT_AND_CONNECT=n

# Modem library
CONFIG_NRF_MODEM_LIB=y

# Heap and stacks
CONFIG_HEAP_MEM_POOL_SIZE=1024
CONFIG_MAIN_STACK_SIZE=4096
CONFIG_SYSTEM_WORKQUEUE_STACK_SIZE=2048

# LTE parameters
## Network Mode / LTE category
#CONFIG_LTE_NETWORK_MODE_LTE_M_GPS=y
CONFIG_LTE_NETWORK_MODE_NBIOT_GPS=y

## PSM
CONFIG_UDP_PSM_ENABLE=y
CONFIG_LTE_PSM_REQ_RPTAU="00100001"
CONFIG_LTE_PSM_REQ_RAT="00000000"

## eDRX
CONFIG_UDP_EDRX_ENABLE=n
CONFIG_LTE_EDRX_REQ_VALUE_LTE_M="1001"

## RAI
CONFIG_UDP_RAI_ENABLE=y
CONFIG_LTE_RAI_REQ_VALUE="3"

#CoAP
CONFIG_COAP=y
```

## nrf9160dk_nrf9160_ns.overlay
```dts
&gpio0 {
	sense-edge-mask = <((1 << 6) | (1 << 7)| (1 << 8)| (1 << 9))>;
};
```

## src/main.c
```c
/*
 * Copyright (c) 2020 Nordic Semiconductor ASA
 *
 * SPDX-License-Identifier: LicenseRef-Nordic-5-Clause
 */

#include <zephyr/kernel.h>
#include <stdio.h>
#include <modem/lte_lc.h>
#include <zephyr/net/socket.h>
#include <zephyr/device.h>
#include <zephyr/drivers/gpio.h>
#include <zephyr/net/coap.h>
#include <zephyr/random/rand32.h>
#include <date_time.h>
#include <zephyr/device.h>
#include <zephyr/devicetree.h>
#include <zephyr/pm/device.h>
#include <nrf_modem_gnss.h>

LOG_MODULE_REGISTER(gnss_udp, LOG_LEVEL_INF);


#define BT1_NODE DT_ALIAS(sw0)
#define BT2_NODE DT_ALIAS(sw1)

static const struct gpio_dt_spec buttons[] = {
	GPIO_DT_SPEC_GET_OR(BT1_NODE, gpios,
						{0}),
	GPIO_DT_SPEC_GET_OR(BT2_NODE, gpios,
						{0})};
static struct gpio_callback button_cb_data[2];

#define MESSAGE_SIZE 242
#define MESSAGE_TO_SEND "Hello from GNSS UDP"
#define SSTRLEN(s) (sizeof(s) - 1)

static int sock;
static struct sockaddr_storage server;

static volatile enum state_type { LTE_STATE_ON,
								  LTE_STATE_OFFLINE,
								  LTE_STATE_BUSY } LTE_Connection_Current_State;
static volatile enum state_type LTE_Connection_Target_State;

//CoAP Definitions
static uint16_t next_token;
#define APP_COAP_VERSION 1
#define APP_COAP_MAX_MSG_LEN 1280
static uint8_t coap_buf[APP_COAP_MAX_MSG_LEN];
#define CONFIG_COAP_SERVER_HOSTNAME "californium.eclipseprojects.io"
#define CONFIG_COAP_SERVER_PORT 5683
#define CONFIG_COAP_TX_RESOURCE "large-update"

//GPS Definitions
static uint8_t coap_payload[MESSAGE_SIZE];
static struct nrf_modem_gnss_pvt_data_frame pvt_data;
static int64_t gnss_start_time;
static bool first_fix = false;

static bool uart_state = true;

static K_SEM_DEFINE(time_sem, 0, 1);
static int server_resolve(void)
{
	/* STEP 6.1 - Call getaddrinfo() to get the IP address of the echo server */
	int err;
	struct addrinfo *result;
	struct addrinfo hints = {
		.ai_family = AF_INET,
		.ai_socktype = SOCK_DGRAM
	};
	char ipv4_addr[NET_IPV4_ADDR_LEN];

	err = getaddrinfo(CONFIG_COAP_SERVER_HOSTNAME, NULL, &hints, &result);
	if (err != 0) {
		LOG_ERR("ERROR: getaddrinfo failed %d", err);
		return -EIO;
	}

	if (result == NULL) {
		LOG_ERR("ERROR: Address not found");
		return -ENOENT;
	}

	/* IPv4 Address. */
	struct sockaddr_in *server4 = ((struct sockaddr_in *)&server);

	server4->sin_addr.s_addr =
		((struct sockaddr_in *)result->ai_addr)->sin_addr.s_addr;
	server4->sin_family = AF_INET;
	server4->sin_port = htons(CONFIG_COAP_SERVER_PORT);

	inet_ntop(AF_INET, &server4->sin_addr.s_addr, ipv4_addr,
		  sizeof(ipv4_addr));
	LOG_INF("IPv4 Address found %s", ipv4_addr);

	/* Free the address. */
	freeaddrinfo(result);

	return 0;
}

static void server_disconnect(void)
{
	(void)close(sock);
}

static int server_connect(void)
{
	int err;

	sock = socket(AF_INET, SOCK_DGRAM, IPPROTO_UDP);
	if (sock < 0)
	{
		LOG_ERR("Failed to create UDP socket: %d", errno);
		err = -errno;
		goto error;
	}

	err = connect(sock, (struct sockaddr *)&server,
				  sizeof(struct sockaddr_in));
	if (err < 0)
	{
		LOG_ERR("Connect failed : %d", errno);
		goto error;
	}
	LOG_INF("Connected to %s", CONFIG_COAP_SERVER_HOSTNAME);

	next_token = sys_rand32_get();

	return 0;

error:
	server_disconnect();

	return err;
}

static void lte_handler(const struct lte_lc_evt *const evt)
{
	switch (evt->type)
	{
	case LTE_LC_EVT_NW_REG_STATUS:
		LOG_INF("Network registration status: %d",
			   evt->nw_reg_status);

		if ((evt->nw_reg_status != LTE_LC_NW_REG_REGISTERED_HOME) &&
			(evt->nw_reg_status != LTE_LC_NW_REG_REGISTERED_ROAMING))
		{
			if (evt->nw_reg_status == 0)
			{
				LTE_Connection_Current_State = LTE_STATE_OFFLINE;
				LOG_ERR("LTE OFFLINE!");
				break;
			}
			break;
		}

		LOG_INF("Network registration status: %s",
			   evt->nw_reg_status == LTE_LC_NW_REG_REGISTERED_HOME ? "Connected - home network" : "Connected - roaming");
		LTE_Connection_Current_State = LTE_STATE_ON;
		break;
	case LTE_LC_EVT_PSM_UPDATE:
		LOG_INF("PSM parameter update: TAU: %d, Active time: %d",
			   evt->psm_cfg.tau, evt->psm_cfg.active_time);
		break;
	case LTE_LC_EVT_EDRX_UPDATE:
	{
		char log_buf[60];
		ssize_t len;

		len = snprintf(log_buf, sizeof(log_buf),
					   "eDRX parameter update: eDRX: %f, PTW: %f",
					   evt->edrx_cfg.edrx, evt->edrx_cfg.ptw);
		if (len > 0)
		{
			LOG_INF("%s", log_buf);
		}
		break;
	}
	case LTE_LC_EVT_RRC_UPDATE:
		LOG_INF("RRC mode: %s",
			   evt->rrc_mode == LTE_LC_RRC_MODE_CONNECTED ? "Connected" : "Idle");
		break;
	case LTE_LC_EVT_CELL_UPDATE:
		LOG_INF("LTE cell changed: Cell ID: %d, Tracking area: %d",
			   evt->cell.id, evt->cell.tac);
		break;
	default:
		break;
	}
}

static void date_time_evt_handler(const struct date_time_evt *evt)
{
	switch (evt->type) {
	case DATE_TIME_OBTAINED_MODEM:
		LOG_INF("DATE_TIME_OBTAINED_MODEM");
		break;
	case DATE_TIME_OBTAINED_NTP:
		LOG_INF("DATE_TIME_OBTAINED_NTP");
		break;
	case DATE_TIME_OBTAINED_EXT:
		LOG_INF("DATE_TIME_OBTAINED_EXT");
		break;
	case DATE_TIME_NOT_OBTAINED:
		LOG_INF("DATE_TIME_NOT_OBTAINED");
		break;
	default:
		break;
	}
	k_sem_give(&time_sem);
}


static int configure_low_power(void)
{
	int err;
	/** Power Saving Mode */
#ifdef CONFIG_UDP_PSM_ENABLE
	err = lte_lc_psm_req(true);
#else
	err = lte_lc_psm_req(false);
#endif /* CONFIG_UDP_PSM_ENABLE */
	if (err)
		{
			LOG_ERR("lte_lc_psm_req, error: %d", err);
		}


	/** Release Assistance Indication  */
#ifdef CONFIG_UDP_RAI_ENABLE
	err = lte_lc_rai_req(true);
#else
	err = lte_lc_rai_req(false);
#endif /* CONFIG_UDP_RAI_ENABLE */
	if (err)
	{
		LOG_ERR("lte_lc_rai_req, error: %d", err);
	}

	return err;
}

char* get_timestamp() {
	static char timestamp[28]; // allocate space for the timestamp
	int64_t now_ms;
	date_time_now(&now_ms); // get the current time in milliseconds
	time_t now = now_ms / 1000; // convert to seconds
	strftime(timestamp, sizeof(timestamp), "%Y/%m/%d - %H:%M:%S (UTC)", localtime(&now)); // format the timestamp
	return timestamp;
}

static void coap_put_work_fn(struct k_work *work)
{
	int err;
	struct coap_packet request;
	if (sock < 0)
	{
		LOG_ERR("Socket not connected");
		return;
	}

	next_token++;

	/* STEP 8.1 - Initialize the CoAP packet and append the resource path */
	err = coap_packet_init(&request, coap_buf, sizeof(coap_buf),
			       APP_COAP_VERSION, COAP_TYPE_NON_CON,
			       sizeof(next_token), (uint8_t *)&next_token,
			       COAP_METHOD_PUT, coap_next_id());
	if (err < 0) {
		LOG_ERR("Failed to create CoAP request, %d", err);
		return;
	}

	err = coap_packet_append_option(&request, COAP_OPTION_URI_PATH,
					(uint8_t *)CONFIG_COAP_TX_RESOURCE,
					strlen(CONFIG_COAP_TX_RESOURCE));
	if (err < 0) {
		LOG_ERR("Failed to encode CoAP option, %d", err);
		return;
	}

	/* STEP 8.2 - Append the content format as plain text */
	const uint8_t text_plain = COAP_CONTENT_FORMAT_TEXT_PLAIN;
	err = coap_packet_append_option(&request, COAP_OPTION_CONTENT_FORMAT,
					&text_plain,
					sizeof(text_plain));
	if (err < 0) {
		LOG_ERR("Failed to encode CoAP option, %d", err);
		return;
	}

	/* STEP 8.3 - Add the payload to the message */
	err = coap_packet_append_payload_marker(&request);
	if (err < 0) {
		LOG_ERR("Failed to append payload marker, %d", err);
		return;
	}

	/*	Using sizeof(coap_payload) to send the full coap_payload(MESSAGE_SIZE)
			for maximum power measurement.
		Change to strlen(coap_payload) to send only the current payload size.
	*/
	LOG_INF("Coap Payload: %s", coap_payload);
	LOG_INF("Coap Payload Size: %d", strlen(coap_payload));
	LOG_HEXDUMP_INF(coap_payload, strlen(coap_payload), "Coap Payload");
	err = coap_packet_append_payload(&request, (uint8_t *)coap_payload, strlen(coap_payload));
	if (err < 0) {
		LOG_ERR("Failed to append payload, %d", err);
		return;
	}


#ifdef CONFIG_UDP_RAI_ENABLE
	err = setsockopt(sock, SOL_SOCKET, SO_RAI_LAST , NULL, 0);
	if (err < 0) {
		LOG_ERR("Failed to set socket options, %d", errno);
		return;
	}
#endif

	err =  send(sock, request.data, request.offset, 0);
	if (err < 0)
	{
		LOG_ERR("Failed to transmit UDP packet, %d", err);
		return;
	}
	//server_disconnect();
}
K_WORK_DEFINE(coap_put_work, coap_put_work_fn);

static void uart0_set_enable(bool enable)
{
	const struct device *uart_dev = DEVICE_DT_GET(DT_NODELABEL(uart0));

	if (!device_is_ready(uart_dev)) {
		return;
	}

	pm_device_action_run(uart_dev, enable ? PM_DEVICE_ACTION_RESUME : PM_DEVICE_ACTION_SUSPEND);
}


void button_pressed(const struct device *dev, struct gpio_callback *cb,
					uint32_t pins)
{
	int val;

	LOG_INF("Button pressed at %" PRIu32, k_cycle_get_32());

	val = gpio_pin_get_dt(&buttons[0]);
	if (val == 1 && LTE_Connection_Current_State == LTE_STATE_ON) // button1 pressed
	{

#ifndef CONFIG_GNSS_SIMULATE_FIX
		LOG_INF("Send UDP package!");
		k_work_submit(&coap_put_work)
#else
		LOG_INF("Update Fix and send UDP package!");
		gnss_simulate_fix();
#endif


	;
	}

	val = gpio_pin_get_dt(&buttons[1]);
	if (val == 1) // button1 pressed
	{
		LOG_INF("Button 2 pressed.");
		//Toogle uart_state
		uart_state = !uart_state;

		if (uart_state)
		{
			uart0_set_enable(true);
			LOG_INF("UART enabled");

		}
		else
		{
			LOG_INF("UART disabled");
			uart0_set_enable(false);
		}
	}

}

void button_init(void)
{
	int ret;
	for (size_t i = 0; i < ARRAY_SIZE(buttons); i++)
	{
		ret = gpio_pin_configure_dt(&buttons[i], GPIO_INPUT);
		if (ret != 0)
		{
			LOG_ERR("Error %d: failed to configure %s pin %d",
				   ret, buttons[i].port->name, buttons[i].pin);
			return;
		}

		ret = gpio_pin_interrupt_configure_dt(&buttons[i],
											  GPIO_INT_EDGE_TO_ACTIVE);
		if (ret != 0)
		{
			LOG_ERR("Error %d: failed to configure interrupt on %s pin %d",
				   ret, buttons[i].port->name, buttons[i].pin);
			return;
		}

		gpio_init_callback(&button_cb_data[i], button_pressed, BIT(buttons[i].pin));
		gpio_add_callback(buttons[i].port, &button_cb_data[i]);
		LOG_INF("Set up button at %s pin %d", buttons[i].port->name, buttons[i].pin);
	}
}
static void new_fix_work_fn(struct k_work *work)
{
	LOG_INF("Latitude:       %.06f", pvt_data.latitude);
	LOG_INF("Longitude:      %.06f", pvt_data.longitude);
	LOG_INF("Altitude:       %.01f m", pvt_data.altitude);
	LOG_INF("Time (UTC):     %02u:%02u:%02u.%03u",
	       pvt_data.datetime.hour,
	       pvt_data.datetime.minute,
	       pvt_data.datetime.seconds,
	       pvt_data.datetime.ms);

	int err = snprintf(coap_payload, MESSAGE_SIZE, "%s - Latitude: %.06f, Longitude: %.06f", get_timestamp(), pvt_data.latitude, pvt_data.longitude);
	if (err < 0) {
		LOG_ERR("Failed to print to buffer: %d", err);
	}
	k_work_submit(&coap_put_work);

}
K_WORK_DEFINE(new_fix_work, new_fix_work_fn);

#ifndef CONFIG_GNSS_SIMULATE_FIX
static void gnss_event_handler(int event)
{
	int err, num_satellites;

	switch (event) {
	case NRF_MODEM_GNSS_EVT_PVT:
		num_satellites = 0;
		for (int i = 0; i < 12 ; i++) {
			if (pvt_data.sv[i].signal != 0) {
				LOG_INF("sv: %d, cn0: %d", pvt_data.sv[i].sv, pvt_data.sv[i].cn0);
				num_satellites++;
			}
		}
		LOG_INF("Searching. Current satellites: %d", num_satellites);
		err = nrf_modem_gnss_read(&pvt_data, sizeof(pvt_data), NRF_MODEM_GNSS_DATA_PVT);
		if (err) {
			LOG_ERR("nrf_modem_gnss_read failed, err %d", err);
			return;
		}
		if (pvt_data.flags & NRF_MODEM_GNSS_PVT_FLAG_FIX_VALID) {
			k_work_submit(&new_fix_work);
			if (!first_fix) {
				LOG_INF("Time to first fix: %2.1lld s", (k_uptime_get() - gnss_start_time)/1000);
				first_fix = true;
			}
			return;
		}
		/* STEP 5 - Check for the flags indicating GNSS is blocked */
		if (pvt_data.flags & NRF_MODEM_GNSS_PVT_FLAG_DEADLINE_MISSED) {
			LOG_INF("GNSS blocked by LTE activity");
		} else if (pvt_data.flags & NRF_MODEM_GNSS_PVT_FLAG_NOT_ENOUGH_WINDOW_TIME) {
			LOG_INF("Insufficient GNSS time windows");
		}
		break;

	case NRF_MODEM_GNSS_EVT_PERIODIC_WAKEUP:
		LOG_INF("GNSS has woken up");
		break;
	case NRF_MODEM_GNSS_EVT_SLEEP_AFTER_FIX:
		LOG_INF("GNSS enter sleep after fix");
		break;

	/*
	case NRF_MODEM_GNSS_EVT_AGPS_REQ:
		err = nrf_modem_gnss_read(&last_agps,
					     sizeof(last_agps),
					     NRF_MODEM_GNSS_DATA_AGPS_REQ);
		if (err == 0) {
			k_work_submit_to_queue(&gnss_work_q, &agps_data_get_work);
		}
		break;
	*/

	default:
		break;
	}
}

static int gnss_init_and_start(void)
{

	int err = snprintf(coap_payload, MESSAGE_SIZE, "No Initial Fix");
	if (err < 0) {
		LOG_INF("Error formatting CoAP Payload.");
	}

	if (lte_lc_func_mode_set(LTE_LC_FUNC_MODE_NORMAL) != 0) {
		LOG_ERR("Failed to activate GNSS functional mode");
		return -1;
	}

	if (nrf_modem_gnss_event_handler_set(gnss_event_handler) != 0) {
		LOG_ERR("Failed to set GNSS event handler");
		return -1;
	}

	if (nrf_modem_gnss_fix_interval_set(CONFIG_GNSS_PERIODIC_INTERVAL) != 0) {
		LOG_ERR("Failed to set GNSS fix interval");
		return -1;
	}

	if (nrf_modem_gnss_fix_retry_set(CONFIG_GNSS_PERIODIC_TIMEOUT) != 0) {
		LOG_ERR("Failed to set GNSS fix retry");
		return -1;
	}

	LOG_INF("Starting GNSS");
	if (nrf_modem_gnss_start() != 0) {
		LOG_ERR("Failed to start GNSS");
		return -1;
	}

	gnss_start_time = k_uptime_get();

	return 0;
}

#else
void gnss_simulate_fix(void)
{
	int err;
	struct tm timeinfo;
	time_t now = time(NULL);
	gmtime_r(&now, &timeinfo);
	pvt_data.datetime.year = timeinfo.tm_year + 1900;
	pvt_data.datetime.month = timeinfo.tm_mon + 1;
	pvt_data.datetime.day = timeinfo.tm_mday;
	pvt_data.datetime.hour = timeinfo.tm_hour;
	pvt_data.datetime.minute = timeinfo.tm_min;
	pvt_data.datetime.seconds = timeinfo.tm_sec;
	pvt_data.datetime.ms = 0;
	pvt_data.latitude = 48.858370;
	pvt_data.longitude = 2.294481;
	pvt_data.altitude = 0;
	pvt_data.accuracy = 0;
	pvt_data.speed = 0;
	pvt_data.heading = 0;
	pvt_data.flags = NRF_MODEM_GNSS_PVT_FLAG_FIX_VALID;
	k_work_submit(&new_fix_work);
}

void timer_handler(struct k_timer *timer_id)
{
    gnss_simulate_fix();
}
K_TIMER_DEFINE(my_timer, timer_handler, NULL);

#endif


static void modem_init(void)
{
	int err;

	date_time_register_handler(date_time_evt_handler);

	err = lte_lc_init();
	if (err)
	{
		LOG_ERR("Modem initialization failed, error: %d", err);
		return;
	}

}

static void modem_connect(void)
{
	int err;

	err = lte_lc_connect_async(lte_handler);
	if (err)
	{
		LOG_ERR("Connecting to LTE network failed, error: %d",
				err);
		return;
	}

}

static int client_handle_response(uint8_t *buf, int received)
{
	struct coap_packet reply;
	uint8_t token[8];
	uint16_t token_len;
	const uint8_t *payload;
	uint16_t payload_len;
	uint8_t temp_buf[128];
	/* STEP 9.1 - Parse the received CoAP packet */
	int err = coap_packet_parse(&reply, buf, received, NULL, 0);
	if (err < 0) {
		LOG_ERR("Malformed response received: %d", err);
		return err;
	}

	/* STEP 9.2 - Confirm the token in the response matches the token sent */
	token_len = coap_header_get_token(&reply, token);
	if ((token_len != sizeof(next_token)) ||
	    (memcmp(&next_token, token, sizeof(next_token)) != 0)) {
		LOG_ERR("Invalid token received: 0x%02x%02x",
		       token[1], token[0]);
		return 0;
	}

	/* STEP 9.3 - Retrieve the payload and confirm it's nonzero */
	payload = coap_packet_get_payload(&reply, &payload_len);

	if (payload_len > 0) {
		snprintf(temp_buf, MIN(payload_len + 1, sizeof(temp_buf)), "%s", payload);
	} else {
		strcpy(temp_buf, "EMPTY");
	}

	/* STEP 9.4 - Log the header code, token and payload of the response */
	LOG_INF("CoAP response: Code 0x%x, Token 0x%02x%02x, Payload: %s",
	       coap_header_get_code(&reply), token[1], token[0], (char *)temp_buf);

	return 0;
}

void main(void)
{
	int err;
	int received;
	LOG_INF("UDP sample has started");

	button_init();

	LTE_Connection_Current_State = LTE_STATE_BUSY;

	/* Initialize the modem before calling configure_low_power(). This is
	 * because the enabling of RAI is dependent on the
	 * configured network mode which is set during modem initialization.
	 */
	modem_init();
	err = configure_low_power();
	if (err)
	{
		LOG_ERR("Unable to set low power configuration, error: %d",
			   err);
	}
	modem_connect();

	while (LTE_STATE_BUSY == LTE_Connection_Current_State)
	{
		LOG_WRN("lte_set_connection BUSY!");
		k_sleep(K_SECONDS(3));
	}

	date_time_update_async(date_time_evt_handler);
	k_sem_take(&time_sem,K_MINUTES(10));
	if (!date_time_is_valid()) {
		LOG_WRN("Failed to get current time, continuing anyway");
	} else {
		LOG_INF("Current time got ok");
	}


	LOG_WRN("Current time: %s", get_timestamp()); // print the timestamp


	if (server_resolve() != 0) {
		LOG_INF("Failed to resolve server name");
		return;
	}

	if (server_connect() != 0) {
		LOG_INF("Failed to initialize client");
		return;
	}

#ifndef CONFIG_GNSS_SIMULATE_FIX
	if (gnss_init_and_start() != 0) {
		LOG_ERR("Failed to initialize and start GNSS");
		return;
	}
#else
	LOG_INF("GNSS simulation enabled");
	gnss_simulate_fix();
	k_timer_start(&my_timer, K_SECONDS(CONFIG_GNSS_PERIODIC_INTERVAL), K_SECONDS(CONFIG_GNSS_PERIODIC_INTERVAL));
#endif


	while (1) {

		received = recv(sock, coap_buf, sizeof(coap_buf), 0);

		if (received < 0) {
			LOG_ERR("Socket error: %d, exit", errno);
			break;
		}

		if (received == 0) {
			LOG_INF("Empty datagram");
			continue;
		}

		err = client_handle_response(coap_buf, received);
		if (err < 0) {
			LOG_ERR("Invalid response, exit");
			break;

		}

		}
	server_disconnect();
}
```

## src/assistance.c
```c
/*
 * Copyright (c) 2021 Nordic Semiconductor ASA
 *
 * SPDX-License-Identifier: LicenseRef-Nordic-5-Clause
 */

#include <stdlib.h>
#include <zephyr/kernel.h>
#include <zephyr/logging/log.h>
#include <modem/modem_info.h>
#include <modem/modem_jwt.h>
#include <net/nrf_cloud_rest.h>
#if defined(CONFIG_NRF_CLOUD_AGPS)
#include <net/nrf_cloud_agps.h>
#endif /* CONFIG_NRF_CLOUD_AGPS */
#if defined(CONFIG_NRF_CLOUD_PGPS)
#include <net/nrf_cloud_pgps.h>
#endif /* CONFIG_NRF_CLOUD_PGPS */

#include "assistance.h"

LOG_MODULE_DECLARE(gnss_udp, CONFIG_GNSS_SAMPLE_LOG_LEVEL);

static char jwt_buf[600];
static char rx_buf[2048];

#if defined(CONFIG_NRF_CLOUD_AGPS)
static char agps_data_buf[3500];
#endif /* CONFIG_NRF_CLOUD_AGPS */

#if defined(CONFIG_NRF_CLOUD_PGPS)
static struct nrf_modem_gnss_agps_data_frame agps_need;
static struct gps_pgps_request pgps_request;
static struct nrf_cloud_pgps_prediction *prediction;
static struct k_work get_pgps_data_work;
static struct k_work inject_pgps_data_work;
#endif /* CONFIG_NRF_CLOUD_PGPS */

static struct k_work_q *work_q;
static volatile bool assistance_active;

#if defined(CONFIG_NRF_CLOUD_AGPS)
static int serving_cell_info_get(struct lte_lc_cell *serving_cell)
{
	int err;

	err = modem_info_init();
	if (err) {
		return err;
	}

	char resp_buf[MODEM_INFO_MAX_RESPONSE_SIZE];

	err = modem_info_string_get(MODEM_INFO_CELLID,
				    resp_buf,
				    MODEM_INFO_MAX_RESPONSE_SIZE);
	if (err < 0) {
		return err;
	}

	serving_cell->id = strtol(resp_buf, NULL, 16);

	err = modem_info_string_get(MODEM_INFO_AREA_CODE,
				    resp_buf,
				    MODEM_INFO_MAX_RESPONSE_SIZE);
	if (err < 0) {
		return err;
	}

	serving_cell->tac = strtol(resp_buf, NULL, 16);

	/* Request for MODEM_INFO_MNC returns both MNC and MCC in the same string. */
	err = modem_info_string_get(MODEM_INFO_OPERATOR,
				    resp_buf,
				    MODEM_INFO_MAX_RESPONSE_SIZE);
	if (err < 0) {
		return err;
	}

	serving_cell->mnc = strtol(&resp_buf[3], NULL, 10);
	/* Null-terminate MCC, read and store it. */
	resp_buf[3] = '\0';
	serving_cell->mcc = strtol(resp_buf, NULL, 10);

	return 0;
}
#endif /* CONFIG_NRF_CLOUD_AGPS */

#if defined(CONFIG_NRF_CLOUD_PGPS)
static void get_pgps_data_work_fn(struct k_work *work)
{
	ARG_UNUSED(work);

	int err;

	assistance_active = true;

	LOG_INF("Sending request for P-GPS predictions to nRF Cloud...");

	err = nrf_cloud_jwt_generate(0, jwt_buf, sizeof(jwt_buf));
	if (err) {
		LOG_ERR("Failed to generate JWT, error: %d", err);

		goto exit;
	}

	struct nrf_cloud_rest_context rest_ctx = {
		.connect_socket = -1,
		.keep_alive = false,
		.timeout_ms = NRF_CLOUD_REST_TIMEOUT_NONE,
		.auth = jwt_buf,
		.rx_buf = rx_buf,
		.rx_buf_len = sizeof(rx_buf),
		.fragment_size = 0, /* Defaults to CONFIG_NRF_CLOUD_REST_FRAGMENT_SIZE when 0 */
		.status = 0,
		.response = NULL,
		.response_len = 0,
		.total_response_len = 0
	};

	struct nrf_cloud_rest_pgps_request request = {
		.pgps_req = &pgps_request
	};

	err = nrf_cloud_rest_pgps_data_get(&rest_ctx, &request);
	if (err) {
		LOG_ERR("Failed to send P-GPS request, error: %d", err);

		nrf_cloud_pgps_request_reset();

		goto exit;
	}

	LOG_INF("Processing P-GPS response");

	err = nrf_cloud_pgps_process(rest_ctx.response, rest_ctx.response_len);
	if (err) {
		LOG_ERR("Failed to process P-GPS response, error: %d", err);

		nrf_cloud_pgps_request_reset();

		goto exit;
	}

	LOG_INF("P-GPS response processed");

exit:
	assistance_active = false;
}

static void inject_pgps_data_work_fn(struct k_work *work)
{
	ARG_UNUSED(work);

	int err;

	assistance_active = true;

	LOG_INF("Injecting P-GPS ephemerides");

	err = nrf_cloud_pgps_inject(prediction, &agps_need);
	if (err) {
		LOG_ERR("Failed to inject P-GPS ephemerides");
	}

	err = nrf_cloud_pgps_preemptive_updates();
	if (err) {
		LOG_ERR("Failed to request P-GPS updates");
	}

	assistance_active = false;
}

static void pgps_event_handler(struct nrf_cloud_pgps_event *event)
{
	switch (event->type) {
	case PGPS_EVT_AVAILABLE:
		prediction = event->prediction;

		k_work_submit_to_queue(work_q, &inject_pgps_data_work);
		break;

	case PGPS_EVT_REQUEST:
		memcpy(&pgps_request, event->request, sizeof(pgps_request));

		k_work_submit_to_queue(work_q, &get_pgps_data_work);
		break;

	case PGPS_EVT_LOADING:
		LOG_INF("Loading P-GPS predictions");
		assistance_active = true;
		break;

	case PGPS_EVT_READY:
		LOG_INF("P-GPS predictions ready");
		assistance_active = false;
		break;

	default:
		/* No action needed */
		break;
	}
}
#endif /* CONFIG_NRF_CLOUD_PGPS */

int assistance_init(struct k_work_q *assistance_work_q)
{
	work_q = assistance_work_q;

#if defined(CONFIG_NRF_CLOUD_PGPS)
	k_work_init(&get_pgps_data_work, get_pgps_data_work_fn);
	k_work_init(&inject_pgps_data_work, inject_pgps_data_work_fn);

	struct nrf_cloud_pgps_init_param pgps_param = {
		.event_handler = pgps_event_handler,
		/* storage is defined by CONFIG_NRF_CLOUD_PGPS_STORAGE */
		.storage_base = 0u,
		.storage_size = 0u
	};

	if (nrf_cloud_pgps_init(&pgps_param) != 0) {
		LOG_ERR("Failed to initialize P-GPS");
		return -1;
	}
#endif /* CONFIG_NRF_CLOUD_PGPS */

	return 0;
}

int assistance_request(struct nrf_modem_gnss_agps_data_frame *agps_request)
{
	int err = 0;

#if defined(CONFIG_NRF_CLOUD_PGPS)
	/* Store the A-GPS data request for P-GPS use. */
	memcpy(&agps_need, agps_request, sizeof(agps_need));

#if defined(CONFIG_NRF_CLOUD_AGPS)
	if (!agps_request->data_flags) {
		/* No assistance needed from A-GPS, skip directly to P-GPS. */
		nrf_cloud_pgps_notify_prediction();
		return 0;
	}

	/* P-GPS will handle ephemerides, so skip those. */
	agps_request->sv_mask_ephe = 0;
	/* Almanacs are not needed with P-GPS, so skip those. */
	agps_request->sv_mask_alm = 0;
#endif /* CONFIG_NRF_CLOUD_AGPS */
#endif /* CONFIG_NRF_CLOUD_PGPS */
#if defined(CONFIG_NRF_CLOUD_AGPS)
	assistance_active = true;

	err = nrf_cloud_jwt_generate(0, jwt_buf, sizeof(jwt_buf));
	if (err) {
		LOG_ERR("Failed to generate JWT, error: %d", err);
		goto agps_exit;
	}

	struct nrf_cloud_rest_context rest_ctx = {
		.connect_socket = -1,
		.keep_alive = false,
		.timeout_ms = NRF_CLOUD_REST_TIMEOUT_NONE,
		.auth = jwt_buf,
		.rx_buf = rx_buf,
		.rx_buf_len = sizeof(rx_buf),
		.fragment_size = 0, /* Defaults to CONFIG_NRF_CLOUD_REST_FRAGMENT_SIZE when 0 */
		.status = 0,
		.response = NULL,
		.response_len = 0,
		.total_response_len = 0
	};

	struct nrf_cloud_rest_agps_request request = {
		.type = NRF_CLOUD_REST_AGPS_REQ_CUSTOM,
		.agps_req = agps_request,
		.net_info = NULL,
#if defined(CONFIG_NRF_CLOUD_AGPS_FILTERED_RUNTIME)
		.filtered = true,
		/* Note: if you change the mask angle here, you may want to
		 * also change it to match in gnss_init_and_start() in main.c.
		 */
		.mask_angle = CONFIG_NRF_CLOUD_AGPS_ELEVATION_MASK
		/* Note: if CONFIG_NRF_CLOUD_AGPS_FILTERED is enabled but
		 * CONFIG_NRF_CLOUD_AGPS_FILTERED_RUNTIME is not,
		 * the nrf_cloud_rest library will set the above fields to
		 * true and CONFIG_NRF_CLOUD_AGPS_ELEVATION_MASK respectively.
		 * When CONFIG_NRF_CLOUD_AGPS_FILTERED is disabled, it will
		 * set them to false and 0.
		 */
#endif
	};

	struct nrf_cloud_rest_agps_result result = {
		.buf = agps_data_buf,
		.buf_sz = sizeof(agps_data_buf),
		.agps_sz = 0
	};

	struct lte_lc_cells_info net_info = { 0 };

	err = serving_cell_info_get(&net_info.current_cell);
	if (err) {
		LOG_ERR("Could not get cell info, error: %d", err);
	} else {
		/* Network info for the location request. */
		request.net_info = &net_info;
	}

	LOG_INF("Requesting A-GPS data, ephe 0x%08x, alm 0x%08x, flags 0x%02x",
		agps_request->sv_mask_ephe,
		agps_request->sv_mask_alm,
		agps_request->data_flags);

	err = nrf_cloud_rest_agps_data_get(&rest_ctx, &request, &result);
	if (err) {
		LOG_ERR("Failed to get A-GPS data, error: %d", err);
		goto agps_exit;
	}

	LOG_INF("Processing A-GPS data");

	err = nrf_cloud_agps_process(result.buf, result.agps_sz);
	if (err) {
		LOG_ERR("Failed to process A-GPS data, error: %d", err);
		goto agps_exit;
	}

	LOG_INF("A-GPS data processed");

agps_exit:
	assistance_active = false;
#endif /* CONFIG_NRF_CLOUD_AGPS */

#if defined(CONFIG_NRF_CLOUD_PGPS)
	nrf_cloud_pgps_notify_prediction();
#endif /* CONFIG_NRF_CLOUD_PGPS */

	return err;
}

bool assistance_is_active(void)
{
	return assistance_active;
}
```
