## prj.conf
```kconfig
# nothing here
CONFIG_USE_SEGGER_RTT=y

#Config console
CONFIG_RTT_CONSOLE=y
CONFIG_UART_CONSOLE=n
```

## src/main.c
```c
/*
 * Copyright (c) 2012-2014 Wind River Systems, Inc.
 *
 * SPDX-License-Identifier: Apache-2.0
 */

#include <zephyr/kernel.h>

int main(void)
{	
	while(1)
	{
		printk("Hello RTT! %s\n", CONFIG_BOARD);
	}
}
```
