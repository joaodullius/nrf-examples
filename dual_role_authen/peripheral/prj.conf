## CMakeLists.txt
```
# SPDX-License-Identifier: Apache-2.0

cmake_minimum_required(VERSION 3.20.0)
find_package(Zephyr REQUIRED HINTS $ENV{ZEPHYR_BASE})
project(peripheral)

target_sources(app PRIVATE src/main.c src/led_service.c src/periph_role.c)
```

## prj.conf
```kconfig
CONFIG_LOG=y
CONFIG_GPIO=y

CONFIG_BT=y
CONFIG_BT_DEVICE_NAME="Test Peripheral"

CONFIG_BT_PERIPHERAL=y
CONFIG_BT_SMP=y
CONFIG_BT_FIXED_PASSKEY=y

#Settings Persistence
CONFIG_SETTINGS=y
CONFIG_BT_SETTINGS=y
CONFIG_FLASH=y
CONFIG_FLASH_PAGE_LAYOUT=y
CONFIG_FLASH_MAP=y
CONFIG_NVS=y
```

## src/main.c
```c
/* main.c - Application main entry point */

/*
 * Copyright (c) 2015-2016 Intel Corporation
 *
 * SPDX-License-Identifier: Apache-2.0
 */

#include <zephyr/types.h>
#include <stddef.h>
#include <zephyr/sys/printk.h>
#include <zephyr/sys/util.h>

#include <zephyr/logging/log.h>
LOG_MODULE_REGISTER(peripheral, LOG_LEVEL_INF);

#include <zephyr/bluetooth/bluetooth.h>
#include <zephyr/bluetooth/conn.h>
#include <zephyr/bluetooth/gatt.h>
#include <zephyr/bluetooth/hci.h>

#include <zephyr/settings/settings.h>

#include "led_service.h"
#include "periph_role.h"


int main(void)
{
	int err;

	LOG_INF("Starting Peripheral Demo");

	periph_role_init();

	err = bt_enable(NULL);
	if (err) {
		printk("Bluetooth init failed (err %d)", err);
	}

#ifdef CONFIG_BT_SMP
	settings_load();
#endif // CONFIG_BT_SMP

	periph_bt_ready(err);
	
	return 0;
}
```

## src/led_service.h
```c
#ifndef LED_SERVICE_H
#define LED_SERVICE_H

#include <zephyr/bluetooth/bluetooth.h>

// Service UUID
#define LED_SERVICE_UUID BT_UUID_128_ENCODE(0x227a5db3, 0xcae4, 0x435f, 0x8ed1, 0x2db3fbe438c9)

// Led State characteristic
#define LED_STATE_CHAR_UUID BT_UUID_128_ENCODE(0x22f64492, 0xbb02, 0x4ccf, 0x9612, 0xc749be0c897d)

int led_service_init(void);

#endif /* LED_SERVICE_H */
```

## src/periph_role.h
```c
#ifndef PERIPH_ROLE_H
#define PERIPH_ROLE_H

#include <zephyr/bluetooth/bluetooth.h>


int periph_role_init(void);
void periph_bt_ready(int err);


#endif /* PERIPH_ROLE_H */
```
