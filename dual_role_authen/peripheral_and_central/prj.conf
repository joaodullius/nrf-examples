## CMakeLists.txt
```
# SPDX-License-Identifier: Apache-2.0

cmake_minimum_required(VERSION 3.20.0)
find_package(Zephyr REQUIRED HINTS $ENV{ZEPHYR_BASE})
project(peripheral)

target_sources(app PRIVATE src/main.c src/led_service.c src/periph_role.c src/central_role.c)
```

## prj.conf
```kconfig
CONFIG_LOG=y
CONFIG_GPIO=y

#BT Geral
CONFIG_BT=y
CONFIG_BT_SMP=y
CONFIG_BT_MAX_PAIRED=2

#BT Peripheral
CONFIG_BT_DEVICE_NAME="Test Dual Role"
CONFIG_BT_PERIPHERAL=y
CONFIG_BT_FIXED_PASSKEY=y

#BT Central
CONFIG_BT_CENTRAL=y
CONFIG_BT_GATT_CLIENT=y
CONFIG_BT_GATT_DM=y
CONFIG_BT_SCAN=y
CONFIG_BT_SETTINGS=y
CONFIG_BT_GATT_AUTO_DISCOVER_CCC=y
CONFIG_BT_SCAN_FILTER_ENABLE=y
CONFIG_BT_SCAN_UUID_CNT=1
CONFIG_BT_GATT_DM_DATA_PRINT=y
CONFIG_HEAP_MEM_POOL_SIZE=256

#Settings Persistence
CONFIG_SETTINGS=y
CONFIG_BT_SETTINGS=y
CONFIG_FLASH=y
CONFIG_FLASH_PAGE_LAYOUT=y
CONFIG_FLASH_MAP=y
CONFIG_NVS=y
```

## src/main.c
```c
/* main.c - Application main entry point */

/*
 * Copyright (c) 2015-2016 Intel Corporation
 *
 * SPDX-License-Identifier: Apache-2.0
 */

#include <zephyr/types.h>
#include <stddef.h>
#include <zephyr/sys/printk.h>
#include <zephyr/sys/util.h>

#include <zephyr/logging/log.h>
LOG_MODULE_REGISTER(dual_role, LOG_LEVEL_INF);

#include <zephyr/bluetooth/bluetooth.h>
#include <zephyr/bluetooth/conn.h>
#include <zephyr/bluetooth/gatt.h>
#include <zephyr/bluetooth/hci.h>

#include <zephyr/settings/settings.h>

#include "led_service.h"
#include "periph_role.h"
#include "central_role.h"


int main(void)
{
	int err;

	LOG_INF("Starting Peripheral Demo");

	periph_role_init();

	err = bt_enable(NULL);
	if (err) {
		LOG_ERR("Bluetooth init failed (err %d)", err);
	}

#ifdef CONFIG_BT_SMP
	settings_load();
#endif // CONFIG_BT_SMP
	periph_bt_ready(err);
	central_role_init();
	return 0;
}
```

## src/central_role.c
```c
/*
 * Copyright (c) 2015-2016 Intel Corporation
 *
 * SPDX-License-Identifier: Apache-2.0
 */

#include "led_service.h"

#include <zephyr/types.h>
#include <stddef.h>
#include <zephyr/sys/printk.h>
#include <zephyr/sys/util.h>
 
#include <zephyr/logging/log.h>
LOG_MODULE_REGISTER(central_role, LOG_LEVEL_DBG);
 
#include <zephyr/bluetooth/bluetooth.h>
#include <zephyr/bluetooth/conn.h>
#include <zephyr/bluetooth/gatt.h>
#include <bluetooth/gatt_dm.h>
#include <bluetooth/scan.h>

static struct bt_conn *default_conn;
static uint16_t remote_led_char_handle = 0;  // <- novo



static void write_led_state_cb(struct bt_conn *conn, uint8_t err,
                               struct bt_gatt_write_params *params)
{
    if (err == 0) {
        LOG_INF("Write successful");
    } else {
        LOG_ERR("Write failed, ATT error: 0x%02X", err);
    }
}

void central_role_write_led(uint8_t value)
{
    if (!default_conn || remote_led_char_handle == 0) {
        LOG_WRN("Cannot write: no connection or handle");
        return;
    }

    static struct bt_gatt_write_params write_params;

    write_params.handle = remote_led_char_handle;
    write_params.offset = 0;
    write_params.data = &value;
    write_params.length = sizeof(value);
    write_params.func = write_led_state_cb;

    int err = bt_gatt_write(default_conn, &write_params);
    if (err) {
        LOG_ERR("bt_gatt_write() failed (err %d)", err);
    } else {
        LOG_INF("Sent LED write with value: %d", value);
    }
}

uint16_t central_role_get_remote_led_handle(void)
{
    return remote_led_char_handle;
}

static void auth_passkey_display(struct bt_conn *conn, unsigned int passkey)
{
    char addr[BT_ADDR_LE_STR_LEN];
    bt_addr_le_to_str(bt_conn_get_dst(conn), addr, sizeof(addr));
    LOG_INF("Passkey for %s: %06u", addr, passkey);
}

static void auth_passkey_entry(struct bt_conn *conn)
{
    char addr[BT_ADDR_LE_STR_LEN];
    bt_addr_le_to_str(bt_conn_get_dst(conn), addr, sizeof(addr));
    LOG_INF("Enter passkey for %s", addr);
    
    // Use the correct function to enter the passkey
    bt_conn_auth_passkey_entry(conn, 123456);
}

static void auth_cancel(struct bt_conn *conn)
{
    char addr[BT_ADDR_LE_STR_LEN];
    bt_addr_le_to_str(bt_conn_get_dst(conn), addr, sizeof(addr));
    LOG_INF("Pairing cancelled: %s", addr);
}

static void auth_passkey_confirm(struct bt_conn *conn, unsigned int passkey)
{
    char addr[BT_ADDR_LE_STR_LEN];
    bt_addr_le_to_str(bt_conn_get_dst(conn), addr, sizeof(addr));
    LOG_INF("Confirm passkey for %s: %06u", addr, passkey);
    
    // Auto-confirm the passkey
    bt_conn_auth_passkey_confirm(conn);
}

static struct bt_conn_auth_cb conn_auth_callbacks = {
    .passkey_display = auth_passkey_display,
    .passkey_entry = auth_passkey_entry,
    .passkey_confirm = auth_passkey_confirm,
    .cancel = auth_cancel,
};


static void discovery_completed_cb(struct bt_gatt_dm *dm,
                                   void *context)
{
    LOG_INF("The discovery procedure succeeded");

    bt_gatt_dm_data_print(dm);

    const struct bt_gatt_dm_attr *attr = bt_gatt_dm_char_by_uuid(dm,
        BT_UUID_DECLARE_128(LED_STATE_CHAR_UUID));
    if (!attr) {
        LOG_ERR("Characteristic not found");
        bt_gatt_dm_data_release(dm);
        return;
    }

    // Get the characteristic value structure
    struct bt_gatt_chrc *chrc = bt_gatt_dm_attr_chrc_val(attr);
    if (!chrc) {
        LOG_ERR("Failed to get characteristic value");
        bt_gatt_dm_data_release(dm);
        return;
    }

    // Access the value handle from the characteristic
    uint16_t handle = chrc->value_handle;
    LOG_INF("LED State handle: 0x%04x", handle);

    remote_led_char_handle = chrc->value_handle;

    bt_gatt_dm_data_release(dm);
}

static void discovery_service_not_found_cb(struct bt_conn *conn,
					   void *context)
{
	LOG_ERR("The service could not be found during the discovery");
}

static void discovery_error_found_cb(struct bt_conn *conn,
				     int err,
				     void *context)
{
	LOG_ERR("The discovery procedure failed with %d", err);
}


static const struct bt_gatt_dm_cb discovery_cb = {
	.completed = discovery_completed_cb,
	.service_not_found = discovery_service_not_found_cb,
	.error_found = discovery_error_found_cb,
};

static void gatt_discover(struct bt_conn *conn)
{
	int err;

	LOG_DBG("Running Gatt Discover Function");

    static const struct bt_uuid_128 sensor_uuid =BT_UUID_INIT_128(LED_SERVICE_UUID);
	err = bt_gatt_dm_start(conn, &sensor_uuid.uuid, &discovery_cb, NULL);
		if (err) {
			LOG_ERR("Failed to start discovery (err %d)", err);
		}
}

static void connected(struct bt_conn *conn, uint8_t conn_err)
{
	char addr[BT_ADDR_LE_STR_LEN];
	int err;
    

	bt_addr_le_to_str(bt_conn_get_dst(conn), addr, sizeof(addr));

    LOG_DBG("Connected to %s", addr);

	if (conn_err) {
		LOG_INF("Failed to connect to %s (%d)", addr, conn_err);

		if (default_conn == conn) {
			bt_conn_unref(default_conn);
			default_conn = NULL;

			err = bt_scan_start(BT_SCAN_TYPE_SCAN_ACTIVE);
			if (err) {
				LOG_ERR("Scanning failed to start (err %d)",
					err);
			}
		}

		return;
	}

	LOG_INF("Connected: %s", addr);

     // Força elevação de segurança
     err = bt_conn_set_security(conn, BT_SECURITY_L2); 
     if (err) {
         LOG_WRN("Failed to set security (err %d)", err);
     }

    gatt_discover(conn);
}

static void disconnected(struct bt_conn *conn, uint8_t reason)
{
	char addr[BT_ADDR_LE_STR_LEN];
	int err;

	bt_addr_le_to_str(bt_conn_get_dst(conn), addr, sizeof(addr));

	LOG_INF("Disconnected: %s (reason %u)", addr, reason);

	if (default_conn != conn) {
		return;
	}

	bt_conn_unref(default_conn);
	default_conn = NULL;

	err = bt_scan_start(BT_SCAN_TYPE_SCAN_ACTIVE);
	if (err) {
		LOG_ERR("Scanning failed to start (err %d)",
			err);
	}
}

static void security_changed(struct bt_conn *conn, bt_security_t level,
                             enum bt_security_err err)
{
    char addr[BT_ADDR_LE_STR_LEN];
    bt_addr_le_to_str(bt_conn_get_dst(conn), addr, sizeof(addr));

    if (!err) {
        LOG_INF("Security changed: %s level %u", addr, level);
    } else {
        LOG_INF("Security failed: %s level %u err %d", addr, level, err);
    }
}


BT_CONN_CB_DEFINE(conn_callbacks) = {
	.connected = connected,
	.disconnected = disconnected,
    .security_changed = security_changed,
};

static void scan_connecting_error(struct bt_scan_device_info *device_info)
{
	LOG_WRN("Connecting failed");
}

static void scan_connecting(struct bt_scan_device_info *device_info,
			    struct bt_conn *conn)
{
    LOG_DBG("Connecting...");
	default_conn = bt_conn_ref(conn);
}

static void scan_filter_match(struct bt_scan_device_info *info,
    struct bt_scan_filter_match *match, bool connectable)
{  
    char addr[BT_ADDR_LE_STR_LEN];
    bt_addr_le_to_str(info->recv_info->addr, addr, sizeof(addr));
    LOG_DBG("Filter match found %s", addr);

    return;
}

uint8_t scanning_state = 1;

int sensor_scanner_stop(void) {
    int err = bt_scan_stop();
    if (err == 0) {
        scanning_state = 0;
        LOG_INF("Scanning stopped");
    } else {
        LOG_ERR("Failed to stop scanning (err %d)", err);
    }
    return err;
}

int sensor_scanner_start(void) {
    int err = bt_scan_start(BT_SCAN_TYPE_SCAN_ACTIVE);
    if (err == 0) {
        scanning_state = 1;
        LOG_INF("Scanning started");
    } else {
        LOG_ERR("Failed to start scanning (err %d)", err);
    }
    return err;
}

BT_SCAN_CB_INIT(scan_cb, scan_filter_match, NULL, scan_connecting_error, scan_connecting);

static struct bt_le_scan_param scan_param = {
    .type = BT_LE_SCAN_TYPE_ACTIVE,
    .options = BT_LE_SCAN_OPT_NONE,
    .interval = BT_GAP_SCAN_FAST_INTERVAL,
    .window = BT_GAP_SCAN_FAST_WINDOW,
};



 static int scan_init(void)
{
    int err;
    struct bt_scan_init_param init = {
        .connect_if_match = 1,
        .scan_param = &scan_param,
    };
    bt_scan_init(&init);
    bt_scan_cb_register(&scan_cb);


    static const struct bt_uuid_128 sensor_uuid = BT_UUID_INIT_128(LED_SERVICE_UUID);
    char uuid_str[BT_UUID_STR_LEN];
    
    // Convert UUID to string for debugging
    bt_uuid_to_str(&sensor_uuid.uuid, uuid_str, sizeof(uuid_str));
    LOG_DBG("Adding UUID filter: %s", uuid_str);
    
    err = bt_scan_filter_add(BT_SCAN_FILTER_TYPE_UUID, &sensor_uuid.uuid);
    if (err) {
        LOG_ERR("Failed to add filter (err %d)", err);
        return err;
    }
    if (!err) {
        err = bt_scan_filter_enable(BT_SCAN_UUID_FILTER, false);
        if (err) {
            LOG_ERR("Failed to enable filter (err %d)", err);
        } else {
            LOG_INF("Filter enabled for UUID: %s", uuid_str);
        }
    }
    return err;

}

int central_role_init(void) {
	LOG_INF("Starting Central Demo");

    bt_conn_auth_cb_register(&conn_auth_callbacks);

	int err = scan_init();
	if (err) {
		LOG_ERR("Scan init failed: %d", err);
		return err;
	}

	// Start scanning manual
	err = bt_scan_start(BT_SCAN_TYPE_SCAN_ACTIVE);
	if (err) {
		LOG_ERR("Scan start failed: %d", err);
		return err;
	}

	LOG_INF("Scan started");
	return 0;
}
 
```

## src/central_role.h
```c
#ifndef CENTRAL_ROLE_H
#define CENTRAL_ROLE_H

#include <zephyr/bluetooth/bluetooth.h>

int central_role_init(void);
uint16_t central_role_get_remote_led_handle(void);
void central_role_write_led(uint8_t value);



#endif /* CENTRAL_ROLE_H */
```

## src/led_service.c
```c
#include "led_service.h"
#include <zephyr/bluetooth/uuid.h>
#include <zephyr/bluetooth/gatt.h>
#include <zephyr/logging/log.h>
#include <zephyr/drivers/gpio.h>

#ifdef CONFIG_BT_CENTRAL
#include "central_role.h"
#endif

LOG_MODULE_REGISTER(led_service, LOG_LEVEL_INF);

#define LED0_NODE DT_ALIAS(led0)
static const struct gpio_dt_spec led0 = GPIO_DT_SPEC_GET(LED0_NODE, gpios);

static uint8_t led_value; // Valor inicial do LED

static ssize_t on_led_state_write(struct bt_conn *conn, const struct bt_gatt_attr *attr,
    const void *buf, uint16_t len, uint16_t offset, uint8_t flags) {
    // TODO: Implementar callback de escrita para "Led State"
    led_value = *(uint8_t *)buf; // Atualiza o valor do LED com o valor recebido
    LOG_INF("Led State: %d", led_value);
    gpio_pin_set_dt(&led0, led_value);
	
#ifdef CONFIG_BT_CENTRAL
    central_role_write_led(led_value);  
#endif  
    return len;
}

#ifdef CONFIG_BT_SMP
BT_GATT_SERVICE_DEFINE(led_service_svc,
    BT_GATT_PRIMARY_SERVICE(BT_UUID_DECLARE_128(LED_SERVICE_UUID)),
    BT_GATT_CHARACTERISTIC(BT_UUID_DECLARE_128(LED_STATE_CHAR_UUID),
                           BT_GATT_CHRC_WRITE,
                           BT_GATT_PERM_WRITE_AUTHEN,
                           NULL, on_led_state_write, NULL)
);
#else
BT_GATT_SERVICE_DEFINE(led_service_svc,
    BT_GATT_PRIMARY_SERVICE(BT_UUID_DECLARE_128(LED_SERVICE_UUID)),
    BT_GATT_CHARACTERISTIC(BT_UUID_DECLARE_128(LED_STATE_CHAR_UUID),
                           BT_GATT_CHRC_WRITE,
                           BT_GATT_PERM_WRITE,
                           NULL, on_led_state_write, NULL)
);
#endif // CONFIG_BT_SMP
int led_service_init(void) {
    int ret;

    led_value = 0; // Valor inicial do LED

    if (!gpio_is_ready_dt(&led0)) {
        LOG_ERR("Led Service not initialized: GPIO not ready");
		return -1;
	}

	ret = gpio_pin_configure_dt(&led0, GPIO_OUTPUT_ACTIVE);
	if (ret < 0) {
        LOG_ERR("Led Service not initialized: GPIO pin configure failed");
		return -1;
	}

    gpio_pin_set_dt(&led0, led_value); // Inicializa o LED com o valor inicial

    LOG_INF("Led Service service initialized");
    return 0;
}
```

## src/periph_role.c
```c
/*
 * Copyright (c) 2015-2016 Intel Corporation
 *
 * SPDX-License-Identifier: Apache-2.0
 */

 #include <zephyr/types.h>
 #include <stddef.h>
 #include <zephyr/sys/printk.h>
 #include <zephyr/sys/util.h>
 
 #include <zephyr/logging/log.h>
 LOG_MODULE_REGISTER(periph_role, LOG_LEVEL_INF);
 
 #include <zephyr/bluetooth/bluetooth.h>
 #include <zephyr/bluetooth/conn.h>
 #include <zephyr/bluetooth/gatt.h>
 #include <zephyr/bluetooth/hci.h>
 
 #include "led_service.h"
 
 
 // PERIPHERAL SIDE OF THE DUAL ROLE AUTHENTICATION EXAMPLE
 #define DEVICE_NAME CONFIG_BT_DEVICE_NAME
 #define DEVICE_NAME_LEN (sizeof(DEVICE_NAME) - 1)
 
#ifdef CONFIG_BT_SMP
#define FIXED_PASSKEY 123456
#endif // CONFIG_BT_SMP
 
 
 static const struct bt_data ad[] = {
    BT_DATA_BYTES(BT_DATA_FLAGS, BT_LE_AD_NO_BREDR),
#ifndef CONFIG_BT_CENTRAL
    BT_DATA_BYTES(BT_DATA_UUID128_ALL, LED_SERVICE_UUID),
#endif // CONFIG_BT_CENTRAL

 };
 
 static const struct bt_data sd[] = {
     BT_DATA(BT_DATA_NAME_COMPLETE, DEVICE_NAME, DEVICE_NAME_LEN),
 };
 
 
 #ifdef CONFIG_BT_SMP
 static void auth_passkey_display(struct bt_conn *conn, unsigned int passkey)
 {
     char addr[BT_ADDR_LE_STR_LEN];
     bt_addr_le_to_str(bt_conn_get_dst(conn), addr, sizeof(addr));
     LOG_INF("Passkey for %s: %06u\n", addr, passkey);
 }
 
 static void auth_cancel(struct bt_conn *conn)
 {
     char addr[BT_ADDR_LE_STR_LEN];
     bt_addr_le_to_str(bt_conn_get_dst(conn), addr, sizeof(addr));
     LOG_INF("Pairing cancelled: %s\n", addr);
 }
 
 static struct bt_conn_auth_cb conn_auth_callbacks = {
     .passkey_display = auth_passkey_display,
     .cancel = auth_cancel,
 };
 #endif
 
 static void connected(struct bt_conn *conn, uint8_t err)
 {
     struct bt_conn_info info; 
     char addr[BT_ADDR_LE_STR_LEN];
 
     if (err) {
         LOG_INF("Connection failed (err %u)", err);
         return;
     }
     else if(bt_conn_get_info(conn, &info)) {
         LOG_INF("Could not parse connection info");
     }
     else {
         bt_addr_le_to_str(bt_conn_get_dst(conn), addr, sizeof(addr));
         
         LOG_INF("Connection established!");
         LOG_INF("Connected to: %s", addr);
         LOG_INF("Role: %u", info.role);
         LOG_INF("Connection interval: %u", info.le.interval);
         LOG_INF("Slave latency: %u", info.le.latency);
         LOG_INF("Connection supervisory timeout: %u", info.le.timeout);
     }   
 }
 
 
 static void disconnected(struct bt_conn *conn, uint8_t reason)
 {
     printk("Disconnected (reason %u)", reason);
     // Additional disconnection handling code
 }

 #ifdef CONFIG_BT_SMP
 
 static void on_security_changed(struct bt_conn *conn, bt_security_t level,
     enum bt_security_err err)
 {
     char addr[BT_ADDR_LE_STR_LEN];
 
     bt_addr_le_to_str(bt_conn_get_dst(conn), addr, sizeof(addr));
 
     if (!err) {
     LOG_INF("Security changed: %s level %u\n", addr, level);
     } else {
     LOG_INF("Security failed: %s level %u err %d\n", addr, level,
     err);
     }
 }
 #endif // CONFIG_BT_SMP

 static struct bt_conn_cb conn_callbacks = {
     .connected = connected,
     .disconnected = disconnected,
#ifdef CONFIG_BT_SMP
     .security_changed = on_security_changed,
#endif // CONFIG_BT_SMP
 };
 
 void periph_bt_ready(int err)
 {
     char addr_s[BT_ADDR_LE_STR_LEN];
     bt_addr_le_t addr = {0};
     size_t count = 1;
 
     if (err) {
         printk("Bluetooth init failed (err %d)", err);
         return;
     }
 
     printk("Bluetooth initialized");
 
     /* Start advertising */
     err =  bt_le_adv_start(BT_LE_ADV_CONN, ad, ARRAY_SIZE(ad), sd, ARRAY_SIZE(sd));
     if (err) {
         printk("Advertising failed to start (err %d)", err);
         return;
     }
 
 
     /* For connectable advertising you would use
      * bt_le_oob_get_local().  For non-connectable non-identity
      * advertising an non-resolvable private address is used;
      * there is no API to retrieve that.
      */
 
     bt_id_get(&addr, &count);
     bt_addr_le_to_str(&addr, addr_s, sizeof(addr_s));
 
     printk("Beacon started, advertising as %s", addr_s);
 }
 
 int periph_role_init(void)
 {
 
     LOG_INF("Initialing Peripheral Mode");
 
     /* Initialize the Bluetooth Subsystem */
 
     led_service_init();
 
     bt_conn_cb_register(&conn_callbacks);

#ifdef CONFIG_BT_SMP
     bt_conn_auth_cb_register(&conn_auth_callbacks);
     bt_passkey_set(FIXED_PASSKEY); // Set the passkey for pairing
#endif // CONFIG_BT_SMP

     return 0;
 }
 
```
